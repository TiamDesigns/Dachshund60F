## CMakeLists.txt
```
# 2.4 GHz dongle firmware (second nRF52840), Zephyr application.
cmake_minimum_required(VERSION 3.20.0)

# The same USB HID interfaces as the keyboard.
set(DTC_OVERLAY_FILE ${CMAKE_CURRENT_LIST_DIR}/../firmware/app.overlay)

find_package(Zephyr REQUIRED HINTS $ENV{ZEPHYR_BASE})
project(kb_dongle LANGUAGES C)

# The link packets and HID reports come from the keyboard's core; the USB
# device is the keyboard's too (its hooks are in src/hooks.c).
include(${CMAKE_CURRENT_SOURCE_DIR}/../firmware/core/sources.cmake)

target_sources(app PRIVATE
  src/main.c
  src/hooks.c
  src/led.c
  src/radio.c
  ${CMAKE_CURRENT_SOURCE_DIR}/../firmware/src/kb_usb.c
  ${KB_CORE_SOURCES}
)
# firmware/src for the prototypes of the hooks kb_usb.c calls.
target_include_directories(app PRIVATE src ${KB_CORE_INCLUDE_DIRS} ${CMAKE_CURRENT_SOURCE_DIR}/../firmware/src)
```

## Kconfig
```
# Dongle firmware options. USB IDs and strings must match the "dongle"
# entry under "usb" in boards/Dachshund70/board.json (checked by the
# host-lib board tests). firmware/src/kb_usb.c reads the same symbols.

menu "Dachshund70 receiver"

config KB_USB_VID
	hex "USB vendor ID"
	default 0x1209
	help
	  pid.codes VID. The default PID below is a pid.codes TEST PID: not
	  unique, in-house testing only. Never ship it on a dongle that is
	  sold or redistributed.

config KB_USB_PID
	hex "USB product ID"
	default 0x0002

config KB_USB_MANUFACTURER
	string "USB manufacturer string"
	default "Dachshund"

config KB_USB_PRODUCT
	string "USB product string"
	default "Dachshund70 Receiver"

config KB_USB_MAX_POWER_MA
	int "USB bMaxPower in mA"
	default 50
	range 2 500
	help
	  The radio listens all the time: about 10 mA, plus the LED.

endmenu

source "Kconfig.zephyr"
```

## prj.conf
```kconfig
# Base configuration for the dongle firmware (debug builds).
# Release builds add release.conf: west build ... -- -DEXTRA_CONF_FILE=release.conf

CONFIG_GPIO=y
CONFIG_HWINFO=y

# USB (device_next stack): the same three HID interfaces as the keyboard
# (firmware/src/kb_usb.c, firmware/app.overlay), with the dongle's IDs.
# The nRF52840 Dongle board would otherwise put a CDC ACM console on USB.
CONFIG_BOARD_SERIAL_BACKEND_CDC_ACM=n
CONFIG_USB_DEVICE_STACK_NEXT=y
CONFIG_USBD_HID_SUPPORT=y

# Enhanced ShockBurst receiver (PRX), on its own: no Bluetooth here, so no
# timeslots. Payloads up to 72 bytes carry a config frame; the keyboard's
# prj.conf must match.
CONFIG_ESB=y
CONFIG_ESB_MAX_PAYLOAD_LENGTH=72
CONFIG_CLOCK_CONTROL=y
CONFIG_ESB_CLOCK_INIT=y
# The Dachshund70-Dongle PCB has no 32.768 kHz crystal (board.json).
CONFIG_CLOCK_CONTROL_NRF_K32SRC_RC=y

# Debug logging over SEGGER RTT (needs SWD). Never log typed keystrokes.
CONFIG_LOG=y
CONFIG_LOG_DEFAULT_LEVEL=3
CONFIG_USE_SEGGER_RTT=y
CONFIG_LOG_BACKEND_RTT=y
CONFIG_USBD_LOG_LEVEL_WRN=y
CONFIG_UDC_DRIVER_LOG_LEVEL_WRN=y
```

## release.conf
```kconfig
# Release overlay: compiles out all logging and asserts.
CONFIG_LOG=n
CONFIG_PRINTK=n
CONFIG_ASSERT=n
CONFIG_USE_SEGGER_RTT=n
```

## src/main.c
```c
/*
 * 2.4 GHz dongle firmware: a USB receiver for the Dachshund70.
 *
 * To the computer it is the keyboard (the same HID interfaces, from
 * firmware/src/kb_usb.c, with the dongle's own IDs); over the air it
 * relays the keyboard's reports and the config protocol (src/radio.c).
 * The button pairs a keyboard; the LED shows pairing and the link.
 */

#include <zephyr/drivers/gpio.h>
#include <zephyr/kernel.h>
#include <zephyr/logging/log.h>

#include <app_version.h>

#include "kb_usb.h"
#include "led.h"
#include "radio.h"

LOG_MODULE_REGISTER(kb_dongle, LOG_LEVEL_INF);

/* From the board (nRF52840 Dongle, matching board.json's pairButton). */
static const struct gpio_dt_spec button = GPIO_DT_SPEC_GET(DT_ALIAS(sw0), gpios);
static struct gpio_callback button_cb;

#define DEBOUNCE_MS 30

static void button_fn(struct k_work *work)
{
    ARG_UNUSED(work);
    if (gpio_pin_get_dt(&button) > 0) {
        radio_toggle_pairing();
    }
}
static K_WORK_DELAYABLE_DEFINE(button_work, button_fn);

static void on_button(const struct device *dev, struct gpio_callback *cb, uint32_t pins)
{
    ARG_UNUSED(dev);
    ARG_UNUSED(cb);
    ARG_UNUSED(pins);
    k_work_reschedule(&button_work, K_MSEC(DEBOUNCE_MS));
}

static int button_init(void)
{
    if (!gpio_is_ready_dt(&button)) {
        return -ENODEV;
    }
    int err = gpio_pin_configure_dt(&button, GPIO_INPUT);
    err = err ? err : gpio_pin_interrupt_configure_dt(&button, GPIO_INT_EDGE_TO_ACTIVE);
    if (err) {
        return err;
    }
    gpio_init_callback(&button_cb, on_button, BIT(button.pin));
    return gpio_add_callback_dt(&button, &button_cb);
}

int main(void)
{
    LOG_INF("dongle firmware %s", APP_VERSION_STRING);

    if (led_init() != 0) {
        LOG_ERR("status LED unavailable");
    }
    /* Before USB, so the first config request finds the radio. */
    if (radio_init() != 0) {
        LOG_ERR("radio unavailable");
    }
    if (kb_usb_init() != 0) {
        LOG_ERR("USB init failed");
    }
    if (button_init() != 0) {
        LOG_ERR("pairing button unavailable");
    }
    return 0;
}
```

## src/hooks.c
```c
/*
 * What the keyboard's USB device (firmware/src/kb_usb.c) calls back into.
 * On the keyboard these reach the scan loop, the indicators and the
 * battery gauge; here they reach the radio and the status LED.
 */

#include "indicators.h"
#include "keyboard.h"
#include "power.h"

#include "led.h"
#include "radio.h"

/* The host changed something the keyboard should hear about (lock LEDs, its state). */
void keyboard_poke(void)
{
    radio_status_changed();
}

void indicators_set_asleep(bool asleep)
{
    led_set_asleep(asleep);
}

/* No battery here. */
void power_poke(void)
{
}
```

## src/led.c
```c
#include "led.h"

#include <zephyr/drivers/gpio.h>
#include <zephyr/kernel.h>
#include <zephyr/logging/log.h>
#include <zephyr/sys/atomic.h>

LOG_MODULE_REGISTER(led, LOG_LEVEL_INF);

/* Pins from the board (nRF52840 Dongle, matching board.json's dongle section). */
static const struct gpio_dt_spec red = GPIO_DT_SPEC_GET(DT_ALIAS(led1_red), gpios);
static const struct gpio_dt_spec green = GPIO_DT_SPEC_GET(DT_ALIAS(led1_green), gpios);
static const struct gpio_dt_spec blue = GPIO_DT_SPEC_GET(DT_ALIAS(led1_blue), gpios);

#define R 1u
#define G 2u
#define B 4u

#define BLINK_MS 250
#define SHOW_MS 1000

static atomic_t pattern = ATOMIC_INIT(LED_OFF);
static atomic_t asleep;
static atomic_t step;

static void set(unsigned rgb)
{
    if (atomic_get(&asleep)) {
        rgb = 0;
    }
    (void)gpio_pin_set_dt(&red, (rgb & R) != 0);
    (void)gpio_pin_set_dt(&green, (rgb & G) != 0);
    (void)gpio_pin_set_dt(&blue, (rgb & B) != 0);
}

static void led_fn(struct k_work *work);
static K_WORK_DELAYABLE_DEFINE(led_work, led_fn);

static void led_fn(struct k_work *work)
{
    ARG_UNUSED(work);
    atomic_val_t n = atomic_inc(&step);

    switch ((enum led_pattern)atomic_get(&pattern)) {
    case LED_PAIRING:
        set(n % 2 == 0 ? B : 0);
        k_work_schedule(&led_work, K_MSEC(BLINK_MS));
        return;
    case LED_PAIRED:
        if (n < 6) {
            set(n % 2 == 0 ? G : 0);
            k_work_schedule(&led_work, K_MSEC(BLINK_MS));
            return;
        }
        break;
    case LED_LINK_UP:
    case LED_LINK_DOWN:
    case LED_HELLO:
        if (n == 0) {
            enum led_pattern p = (enum led_pattern)atomic_get(&pattern);
            set(p == LED_LINK_UP ? G : p == LED_LINK_DOWN ? R : R | G | B);
            k_work_schedule(&led_work, K_MSEC(p == LED_HELLO ? SHOW_MS / 2 : SHOW_MS));
            return;
        }
        break;
    default:
        break;
    }
    atomic_set(&pattern, LED_OFF);
    set(0);
}

void led_show(enum led_pattern p)
{
    /* Pairing outranks the one-off patterns until it ends. */
    if (atomic_get(&pattern) == LED_PAIRING && p != LED_OFF && p != LED_PAIRED) {
        return;
    }
    atomic_set(&pattern, p);
    atomic_set(&step, 0);
    k_work_reschedule(&led_work, K_NO_WAIT);
}

void led_set_asleep(bool on)
{
    atomic_set(&asleep, on ? 1 : 0);
    if (on) {
        set(0);
    }
}

int led_init(void)
{
    const struct gpio_dt_spec *leds[] = {&red, &green, &blue};
    for (size_t i = 0; i < ARRAY_SIZE(leds); i++) {
        if (!gpio_is_ready_dt(leds[i]) || gpio_pin_configure_dt(leds[i], GPIO_OUTPUT_INACTIVE)) {
            LOG_ERR("status LED unavailable");
            return -ENODEV;
        }
    }
    led_show(LED_HELLO);
    return 0;
}
```

## src/led.h
```c
/*
 * The status LED (RGB). Pairing blinks blue until it ends; the other
 * patterns show once and go dark, so the dongle doesn't glow on the desk.
 */
#ifndef LED_H
#define LED_H

#include <stdbool.h>

enum led_pattern {
    LED_OFF,
    LED_PAIRING,  /* blue, blinking, until LED_OFF or another pattern */
    LED_PAIRED,   /* green, three blinks */
    LED_LINK_UP,  /* green for a second: the keyboard is in range */
    LED_LINK_DOWN, /* red for a second: the keyboard went quiet */
    LED_HELLO,    /* white for a moment at power-on */
};

int led_init(void);

/* Safe from any thread. */
void led_show(enum led_pattern p);

/* The USB host is asleep: dark until it wakes. */
void led_set_asleep(bool asleep);

#endif /* LED_H */
```

## src/radio.c
```c
#include "radio.h"

#include <errno.h>
#include <string.h>

#include <zephyr/drivers/hwinfo.h>
#include <zephyr/kernel.h>
#include <zephyr/logging/log.h>
#include <zephyr/sys/atomic.h>

#include <esb.h>

#include "kb/hid.h"
#include "kb/link.h"
#include "kb/protocol_gen.h"
#include "kb_usb.h"
#include "led.h"

LOG_MODULE_REGISTER(radio, LOG_LEVEL_INF);

BUILD_ASSERT(CONFIG_ESB_MAX_PAYLOAD_LENGTH >= KB_LINK_PAYLOAD_MAX,
             "ESB payloads must hold a config frame");
BUILD_ASSERT(KB_PROTO_REPORT_SIZE == KB_LINK_CONFIG_SIZE, "config frames fit the link");

#define PIPE_LINK 0
#define PIPE_PAIR 1

/*
 * The keyboard polls at least every 100 ms while it is awake; longer than
 * this without a packet and it is asleep or gone, so its keys are let go.
 */
#define LINK_TIMEOUT_MS 400
#define WATCH_MS 100
#define PAIR_TIMEOUT_MS 30000
/* At most one fresh pairing offer this often (each request takes one). */
#define OFFER_EVERY_MS 200

static K_THREAD_STACK_DEFINE(radio_stack, 1536);
static struct k_work_q radio_q;
/* Every ESB call from a thread holds this; the interrupt only reads packets. */
static K_MUTEX_DEFINE(esb_lock);

static struct kb_link_address own;
static bool link_up;            /* radio_q */
static uint32_t last_rx;        /* radio_q */
static bool pairing;            /* radio_q */
static uint32_t pairing_until;  /* radio_q */
static uint32_t last_offer;     /* radio_q */
static struct kb_link_status sent_status; /* radio_q: what the keyboard was last told */
static bool status_sent;        /* radio_q */

K_MSGQ_DEFINE(rx_queue, sizeof(struct esb_payload), 8, 4);

static void rx_fn(struct k_work *work);
static void status_fn(struct k_work *work);
static void watch_fn(struct k_work *work);
static void pair_fn(struct k_work *work);
static K_WORK_DEFINE(rx_work, rx_fn);
static K_WORK_DEFINE(status_work, status_fn);
static K_WORK_DELAYABLE_DEFINE(watch_work, watch_fn);
static K_WORK_DEFINE(pair_work, pair_fn);

/* ESB's event interrupt: hand received packets to the work queue. */
static void on_esb_event(const struct esb_evt *evt)
{
    if (evt->evt_id != ESB_EVENT_RX_RECEIVED) {
        return;
    }
    struct esb_payload rx;
    while (esb_read_rx_payload(&rx) == 0) {
        if (k_msgq_put(&rx_queue, &rx, K_NO_WAIT) != 0) {
            LOG_WRN("radio packet dropped");
        }
    }
    k_work_submit_to_queue(&radio_q, &rx_work);
}

static int queue_ack(uint8_t pipe, const uint8_t *data, size_t len)
{
    if (len == 0) {
        return -EINVAL;
    }
    struct esb_payload p = {.pipe = pipe, .length = (uint8_t)len};
    memcpy(p.data, data, len);
    k_mutex_lock(&esb_lock, K_FOREVER);
    int err = esb_write_payload(&p);
    k_mutex_unlock(&esb_lock);
    return err;
}

static struct kb_link_status usb_status(void)
{
    struct kb_link_status s = {.locks = kb_usb_locks()};
    if (kb_usb_ready()) {
        s.flags |= KB_LINK_USB_READY;
    }
    if (kb_usb_boot_protocol()) {
        s.flags |= KB_LINK_BOOT_PROTOCOL;
    }
    return s;
}

/* radio_q: tell the keyboard the host's state, if it changed or the host wants everything again. */
static void send_status(bool force_resync)
{
    struct kb_link_status s = usb_status();
    if (kb_usb_take_resync() || force_resync) {
        s.flags |= KB_LINK_RESYNC;
    }
    if (status_sent && s.locks == sent_status.locks && s.flags == sent_status.flags) {
        return;
    }
    uint8_t buf[KB_LINK_PAYLOAD_MAX];
    int err = queue_ack(PIPE_LINK, buf, kb_link_encode_status(&s, buf));
    if (err == 0) {
        sent_status = s;
        /* Only the change is news: a resync isn't asked for twice. */
        sent_status.flags &= (uint8_t)~KB_LINK_RESYNC;
        status_sent = true;
    } else if (s.flags & KB_LINK_RESYNC) {
        LOG_WRN("status not queued (%d)", err);
    }
}

static void status_fn(struct k_work *work)
{
    ARG_UNUSED(work);
    if (link_up) {
        send_status(false);
    }
}

void radio_status_changed(void)
{
    k_work_submit_to_queue(&radio_q, &status_work);
}

/* The last report of each kind sent to USB (radio_q), to know what is still held. */
#define REPORT_KINDS (KB_HID_REPORT_MOUSE + 1)
static uint8_t last_report[REPORT_KINDS][KB_HID_EXTRA_REPORT_MAX];
static bool report_seen[REPORT_KINDS];

BUILD_ASSERT(KB_HID_BOOT_REPORT_SIZE <= KB_HID_EXTRA_REPORT_MAX &&
                 KB_HID_MOUSE_REPORT_SIZE <= KB_HID_EXTRA_REPORT_MAX,
             "every report fits last_report");

static void relay_report(enum kb_hid_report kind, const uint8_t *data, size_t len)
{
    if ((unsigned)kind < REPORT_KINDS && len <= sizeof(last_report[0])) {
        memcpy(last_report[kind], data, len);
        report_seen[kind] = true;
    }
    (void)kb_usb_send(kind, data, len);
}

/*
 * The keyboard went quiet: let go of whatever it left held. Only reports
 * that aren't already released, so a keyboard falling asleep never wakes a
 * sleeping computer.
 */
static void release(enum kb_hid_report report, const uint8_t *data, size_t len, void *ctx)
{
    ARG_UNUSED(ctx);
    if ((unsigned)report >= REPORT_KINDS || !report_seen[report] ||
        memcmp(last_report[report], data, len) == 0) {
        return;
    }
    relay_report(report, data, len);
}

static void set_pipes(bool with_pairing)
{
    k_mutex_lock(&esb_lock, K_FOREVER);
    (void)esb_stop_rx();
    (void)esb_enable_pipes(with_pairing ? BIT(PIPE_LINK) | BIT(PIPE_PAIR) : BIT(PIPE_LINK));
    int err = esb_start_rx();
    k_mutex_unlock(&esb_lock);
    if (err) {
        LOG_ERR("radio restart failed (%d)", err);
    }
}

static void stop_pairing(void)
{
    if (!pairing) {
        return;
    }
    pairing = false;
    set_pipes(false);
    /* Drop a leftover offer; anything else queued is sent again. */
    k_mutex_lock(&esb_lock, K_FOREVER);
    (void)esb_flush_tx();
    k_mutex_unlock(&esb_lock);
    if (link_up) {
        status_sent = false;
        send_status(false);
    }
    led_show(LED_OFF);
    LOG_INF("pairing off");
}

static void offer(uint32_t now)
{
    uint8_t buf[KB_LINK_PAYLOAD_MAX];
    if (queue_ack(PIPE_PAIR, buf, kb_link_encode_pair_offer(&own, buf)) == 0) {
        last_offer = now;
    }
}

static void pair_fn(struct k_work *work)
{
    ARG_UNUSED(work);
    if (pairing) {
        stop_pairing();
        return;
    }
    pairing = true;
    pairing_until = k_uptime_get_32() + PAIR_TIMEOUT_MS;
    set_pipes(true);
    /* Ready before the keyboard asks: an acknowledgement carries only what is already queued. */
    offer(k_uptime_get_32());
    led_show(LED_PAIRING);
    LOG_INF("pairing on for %u s", PAIR_TIMEOUT_MS / 1000);
}

void radio_toggle_pairing(void)
{
    k_work_submit_to_queue(&radio_q, &pair_work);
}

static void on_link_packet(const struct kb_link_packet *pkt, uint32_t now)
{
    last_rx = now;
    if (!link_up) {
        LOG_INF("keyboard in range");
        if (pairing) {
            /* The keyboard took the offer and moved to our address. */
            stop_pairing();
            led_show(LED_PAIRED);
        } else {
            led_show(LED_LINK_UP);
        }
        link_up = true;
        /* It may have missed anything: the host's state, and all its reports again. */
        status_sent = false;
        send_status(true);
    }

    switch (pkt->type) {
    case KB_LINK_REPORT:
        relay_report((enum kb_hid_report)pkt->report.kind, pkt->report.data, pkt->report.len);
        break;
    case KB_LINK_CONFIG:
        if (kb_usb_send_config(pkt->config) != 0) {
            LOG_WRN("config response dropped");
        }
        break;
    default:
        break;
    }
}

static void rx_fn(struct k_work *work)
{
    ARG_UNUSED(work);
    struct esb_payload rx;
    struct kb_link_packet pkt;

    while (k_msgq_get(&rx_queue, &rx, K_NO_WAIT) == 0) {
        uint32_t now = k_uptime_get_32();
        if (kb_link_decode(rx.data, rx.length, &pkt) != 0) {
            continue;
        }
        if (rx.pipe == PIPE_LINK) {
            on_link_packet(&pkt, now);
        } else if (rx.pipe == PIPE_PAIR && pairing && pkt.type == KB_LINK_PAIR &&
                   (uint32_t)(now - last_offer) >= OFFER_EVERY_MS) {
            /* This request took the queued offer; queue the next for a retry. */
            offer(now);
        }
    }
}

static void watch_fn(struct k_work *work)
{
    ARG_UNUSED(work);
    uint32_t now = k_uptime_get_32();

    if (link_up && (uint32_t)(now - last_rx) > LINK_TIMEOUT_MS) {
        link_up = false;
        LOG_INF("keyboard quiet");
        kb_hid_send_released(release, NULL);
        /* Nothing queued for it is current any more. */
        k_mutex_lock(&esb_lock, K_FOREVER);
        (void)esb_flush_tx();
        k_mutex_unlock(&esb_lock);
        if (pairing) {
            offer(now);
        } else {
            led_show(LED_LINK_DOWN);
        }
    }
    if (pairing && (int32_t)(now - pairing_until) >= 0) {
        stop_pairing();
    }
    k_work_schedule_for_queue(&radio_q, &watch_work, K_MSEC(WATCH_MS));
}

/* USB thread: a config request from Doghouse goes to the keyboard, or is refused at once. */
static void on_config_request(const uint8_t *data, size_t len)
{
    uint8_t frame[KB_PROTO_REPORT_SIZE] = {0};
    memcpy(frame, data, MIN(len, sizeof(frame)));
    if (len < KB_PROTO_HEADER_SIZE) {
        return; /* no header to answer */
    }

    uint8_t buf[KB_LINK_PAYLOAD_MAX];
    /* link_up belongs to radio_q; a stale read only costs one refused request. */
    if (link_up && queue_ack(PIPE_LINK, buf, kb_link_encode_config(frame, buf)) == 0) {
        return;
    }
    /* No keyboard to ask: the app waits for it to come back. */
    uint8_t resp[KB_PROTO_REPORT_SIZE] = {0};
    resp[KB_PROTO_OFF_COMMAND] = frame[KB_PROTO_OFF_COMMAND];
    resp[KB_PROTO_OFF_SEQUENCE] = frame[KB_PROTO_OFF_SEQUENCE];
    resp[KB_PROTO_OFF_STATUS] = KB_PROTO_UNREACHABLE;
    (void)kb_usb_send_config(resp);
}

int radio_init(void)
{
    uint8_t id[16];
    ssize_t n = hwinfo_get_device_id(id, sizeof(id));
    if (n <= 0) {
        LOG_ERR("no device ID");
        return -EIO;
    }
    kb_link_address_from_id(id, (size_t)n, &own);

    k_work_queue_start(&radio_q, radio_stack, K_THREAD_STACK_SIZEOF(radio_stack),
                       K_PRIO_COOP(CONFIG_NUM_COOP_PRIORITIES - 2), NULL);
    k_thread_name_set(&radio_q.thread, "radio");

    struct esb_config cfg = ESB_DEFAULT_CONFIG;
    cfg.protocol = ESB_PROTOCOL_ESB_DPL;
    cfg.mode = ESB_MODE_PRX;
    cfg.bitrate = ESB_BITRATE_2MBPS;
    cfg.event_handler = on_esb_event;
    cfg.selective_auto_ack = true;

    const struct kb_link_address *pair = &kb_link_pairing_address;
    const uint8_t prefixes[2] = {own.prefix, pair->prefix};
    k_mutex_lock(&esb_lock, K_FOREVER);
    int err = esb_init(&cfg);
    err = err ? err : esb_set_rf_channel(KB_LINK_CHANNEL);
    err = err ? err : esb_set_base_address_0(own.base);
    err = err ? err : esb_set_base_address_1(pair->base);
    err = err ? err : esb_set_prefixes(prefixes, ARRAY_SIZE(prefixes));
    err = err ? err : esb_enable_pipes(BIT(PIPE_LINK));
    err = err ? err : esb_start_rx();
    k_mutex_unlock(&esb_lock);
    if (err) {
        LOG_ERR("ESB init failed (%d)", err);
        return err;
    }

    kb_usb_set_config_rx(on_config_request);
    k_work_schedule_for_queue(&radio_q, &watch_work, K_MSEC(WATCH_MS));
    LOG_INF("listening on channel %u", KB_LINK_CHANNEL);
    return 0;
}
```

## src/radio.h
```c
/*
 * The 2.4 GHz link, dongle end: Enhanced ShockBurst as PRX on the
 * dongle's own address (from its device ID, kb/link.h). Reports from the
 * keyboard go straight to USB; the host's lock LEDs and state, and config
 * requests from Doghouse, ride back in acknowledgements.
 *
 * Pairing (the button): for 30 s the dongle also listens on the fixed
 * pairing address and offers its address to the first keyboard that asks.
 */
#ifndef RADIO_H
#define RADIO_H

#include <stdbool.h>

int radio_init(void);

/* The USB host's lock LEDs or state changed: tell the keyboard. Safe from any thread. */
void radio_status_changed(void);

/* Start pairing for 30 s, or stop it if it is on. */
void radio_toggle_pairing(void);

#endif /* RADIO_H */
```
