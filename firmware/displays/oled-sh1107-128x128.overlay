/*
 * 1.12" SH1107 128x128 OLED on the J4 display header, such as Pimoroni's
 * 1.12" Mono OLED Breakout (I2C at 0x3C: SDA on J4-3, SCL on J4-4).
 * Settings follow the SH1107 datasheet's 128x128 defaults. If the picture is
 * mirrored or upside down, toggle segment-remap and com-invdir.
 */

/ {
	chosen {
		zephyr,display = &screen;
	};
};

&display_i2c {
	status = "okay";

	screen: ssd1306@3c {
		compatible = "sinowealth,sh1107";
		reg = <0x3c>;
		width = <128>;
		height = <128>;
		segment-offset = <0>;
		page-offset = <0>;
		display-offset = <0>;
		multiplex-ratio = <127>;
		segment-remap;
		com-invdir;
		prechargep = <0x22>;
	};
};
