/*
 * 0.91" SSD1306 128x32 OLED on the J4 display header
 * (I2C at 0x3C: SDA on J4-3, SCL on J4-4).
 * Panel settings from Zephyr's boards/shields/ssd1306 definitions.
 */

/ {
	chosen {
		zephyr,display = &screen;
	};
};

&display_i2c {
	status = "okay";

	screen: ssd1306@3c {
		compatible = "solomon,ssd1306";
		reg = <0x3c>;
		width = <128>;
		height = <32>;
		segment-offset = <0>;
		page-offset = <0>;
		display-offset = <0>;
		multiplex-ratio = <31>;
		segment-remap;
		com-invdir;
		com-sequential;
		prechargep = <0x22>;
	};
};
