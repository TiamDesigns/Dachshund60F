## CMakeLists.txt
```
# Keyboard firmware (nRF52840), Zephyr application.
# Build for the Dachshund70 with -DBOARD_ROOT=<repo root> (see CLAUDE.md).
# Add a screen with -DEXTRA_DTC_OVERLAY_FILE=displays/<panel>.overlay.
cmake_minimum_required(VERSION 3.20.0)

find_package(Zephyr REQUIRED HINTS $ENV{ZEPHYR_BASE})
project(kb_firmware LANGUAGES C)

# Hardware-independent keymap logic, shared with the host unit tests.
include(${CMAKE_CURRENT_SOURCE_DIR}/core/sources.cmake)

target_sources(app PRIVATE
  src/main.c
  src/bootloader.c
  src/config.c
  src/encoder_input.c
  src/fw_info.c
  src/indicators.c
  src/kb_ble.c
  src/kb_usb.c
  src/keyboard.c
  src/matrix.c
  src/output.c
  src/power.c
  src/storage.c
  ${KB_CORE_SOURCES}
)
# A board on one of Nordic's own boards (the Pup on the nRF52840 Dongle:
# boards/nrf52840dongle_nrf52840.*) brings its default keymap from
# boards/<KB_MODEL>/firmware/.
set(KB_BOARD_DIR ${CMAKE_CURRENT_SOURCE_DIR}/../boards/${CONFIG_KB_MODEL}/firmware)
if(EXISTS ${KB_BOARD_DIR}/default_keymap.c)
  target_sources(app PRIVATE ${KB_BOARD_DIR}/default_keymap.c)
  target_include_directories(app PRIVATE ${KB_BOARD_DIR} src)
  target_compile_definitions(app PRIVATE KB_BOARD_KEYMAP)
else()
  target_sources(app PRIVATE src/default_keymap.c)
endif()
target_sources_ifdef(CONFIG_KB_SCREEN app PRIVATE src/status_screen.c)
target_sources_ifdef(CONFIG_KB_DISPLAY_ROTATE app PRIVATE src/display_rotate.c)
target_sources_ifdef(CONFIG_KB_DONGLE app PRIVATE src/kb_esb.c)
target_include_directories(app PRIVATE ${KB_CORE_INCLUDE_DIRS})
```

## Kconfig
```
# Keyboard firmware options. USB IDs and strings must match
# boards/Dachshund70/board.json (checked by the host-lib board tests).

menu "Dachshund70 keyboard"

config KB_USB_VID
	hex "USB vendor ID"
	default 0x1209
	help
	  pid.codes VID. The default PID below is a pid.codes TEST PID: not
	  unique, in-house testing only. Never ship it on a board that is
	  sold or redistributed.

config KB_USB_PID
	hex "USB product ID"
	default 0x0001

config KB_USB_MANUFACTURER
	string "USB manufacturer string"
	default "Dachshund"

config KB_USB_PRODUCT
	string "USB product string"
	default "Dachshund70"

config KB_USB_MAX_POWER_MA
	int "USB bMaxPower in mA"
	default 500
	range 2 500
	help
	  The charger draws up to 500 mA from VBUS.

config KB_DONGLE
	bool "2.4 GHz dongle output"
	default y
	select ESB
	select ESB_MPSL_TIMESLOT
	help
	  Keys can also go to a Dachshund receiver (dongle/) over Enhanced
	  ShockBurst, sharing the radio with Bluetooth through the MPSL
	  timeslot API: OUT_2G4, RF_PAIR, get_dongle and pair_dongle. The
	  link isn't encrypted yet.

config KB_MODEL
	string "Keyboard definition name, reported to the host"
	default "Dachshund70"
	help
	  The folder name under boards/; the configurator loads that
	  board's keyboard.json. At most 16 bytes.

config KB_BOOTLOADER_HOLD_MS
	int "Hold time for the recovery key (Esc) that reboots into UF2, in ms"
	default 3000
	help
	  Works from the physical key, whatever the keymap says, so a broken
	  keymap can always be reflashed. QK_BOOT in the keymap reboots at
	  once.

config KB_BOOTLOADER_GPREGRET
	hex "GPREGRET value that keeps the bootloader in update mode"
	default 0x57
	range 0x00 0xff
	help
	  Written before the reboot into the bootloader (recovery key,
	  QK_BOOT, the protocol's bootloader command). 0x57 is the Adafruit
	  UF2 bootloader's; Nordic's nRF5 SDK bootloader, on the nRF52840
	  Dongle, takes 0xB1.

config KB_MATRIX_SCAN_PERIOD_US
	int "Matrix scan period, in microseconds"
	default 1000
	range 250 10000
	help
	  1000 scans at 1 kHz.

config KB_WAKE_ON_PRESS
	bool "Scan at once when a key goes down"
	default y
	help
	  While no key is down, every column is driven high between scans
	  and the rows wait on an interrupt, so the first key of a burst is
	  scanned the moment it closes instead of at the next tick (half a
	  period sooner on average). Costs a few microseconds per scan.
	  Idle always waits this way, whatever this says.

config KB_IDLE_MS
	int "Quiet time before the scan stops and waits for a key, in ms (0 = never)"
	default 500
	range 0 60000
	help
	  Quiet: no key down, and nothing waiting on time (tap-hold, combos,
	  Caps Word, Leader, macros, mouse keys). The scan then sleeps until
	  a key or the encoder moves, and starts at once when one does, so
	  this costs no delay.

config KB_LIGHTS_OFF_S
	int "On battery: quiet time before the indicators and an OLED go dark, in s (0 = never)"
	default 60
	range 0 3600

config KB_ADVERTISING_OFF_S
	int "On battery: quiet time before Bluetooth stops advertising, in s (0 = never)"
	default 300
	range 0 86400
	help
	  A connected host stays connected. Without a host, the board stops
	  advertising until the next key. Deep sleep (the sleep timeout in
	  the settings) stops it anyway.

config KB_MATRIX_SETTLE_US
	int "Wait after driving a column before reading the rows, in microseconds"
	default 5
	range 0 100

config KB_MATRIX_RELEASE_US
	int "Longest wait for the rows to fall after releasing a column, in microseconds"
	default 10
	range 0 100
	help
	  The scan moves on as soon as every row reads low, so this only
	  costs time while a key in that column is pressed.

config KB_ENCODER_STEPS_PER_DETENT
	int "Encoder transitions per detent"
	default 4
	range 1 4
	help
	  4 for an encoder with as many pulses as detents (the
	  PEC12R-4220F-S0024: 24 and 24), 2 for one with half as many
	  pulses. If one click turns two steps or none, this is wrong.

choice KB_DEBOUNCE_ALGO
	prompt "Debounce algorithm"
	default KB_DEBOUNCE_EAGER_PRESS
	help
	  See firmware/core/include/kb/debounce.h. The host can change this
	  at run time once the settings protocol exists (phase 10).

config KB_DEBOUNCE_EAGER_PRESS
	bool "Eager press, deferred release, per key"

config KB_DEBOUNCE_EAGER_PER_KEY
	bool "Eager, per key"

config KB_DEBOUNCE_DEFER_PER_KEY
	bool "Deferred, per key"

config KB_DEBOUNCE_EAGER_GLOBAL
	bool "Eager, whole matrix"

config KB_DEBOUNCE_DEFER_GLOBAL
	bool "Deferred, whole matrix"

endchoice

config KB_DEBOUNCE_MS
	int "Debounce time, in ms"
	default 5
	range 0 100

config KB_TAPPING_TERM_MS
	int "Tapping term for layer-tap and mod-tap keys, in ms"
	default 200
	range 50 2000

config KB_NKRO
	bool "N-key rollover at power-up"
	default y
	help
	  Keys go in the NKRO report on the extra HID interface. A host that
	  asks for boot protocol (a BIOS or KVM) always gets the 6-key boot
	  report. NK_TOGG in the keymap switches at run time; the host sets
	  it once the settings protocol exists (phase 10).

config KB_SLEEP_TIMEOUT_MIN
	int "Default sleep timeout, in minutes (0 = never)"
	default 15
	range 0 240
	help
	  Stored with the settings. On battery, after this long without use
	  the board goes into deep sleep (System OFF), and a key press wakes
	  it. Never on USB power.

config KB_INDICATOR_BRIGHTNESS
	int "Default indicator LED brightness, in percent"
	default 13
	range 0 100
	help
	  Six SK6812s at full white draw about 360 mA, so keep this low.

config KB_LED_SELFTEST
	bool "Walk the indicator LED chain once at power-up"
	default y
	help
	  One LED at a time in chain order, red, green then blue, 200 ms
	  each (3.6 s for six LEDs). Shows the chain and colour order at
	  bring-up; the indicators take over afterwards.

DT_CHOSEN_ZEPHYR_DISPLAY := zephyr,display

menuconfig KB_SCREEN
	bool "Status screen on the J4 display header"
	default $(dt_chosen_enabled,$(DT_CHOSEN_ZEPHYR_DISPLAY))
	select DISPLAY
	select CHARACTER_FRAMEBUFFER
	help
	  On by default when a panel overlay from firmware/displays/ is in
	  the build (it sets the zephyr,display chosen node).

if KB_SCREEN

config KB_SCREEN_TEXT
	string "Custom text shown under the status widgets"
	default "Dachshund70"
	help
	  Up to 23 characters; longer text is cut off. Shown only when the
	  panel has a free row after the enabled status widgets.

config KB_SCREEN_SHOW_LAYER
	bool "Show the active layer"
	default y

config KB_SCREEN_SHOW_BATTERY
	bool "Show the battery level"
	default y

config KB_SCREEN_SHOW_LOCKS
	bool "Show Caps, Num and Scroll Lock"
	default y

config KB_SCREEN_SHOW_CONNECTION
	bool "Show the connection (USB, BT1-BT9, 2.4G)"
	default y

config KB_SCREEN_SHOW_TEXT
	bool "Show the custom text"
	default y

config KB_SCREEN_FONT_INDEX
	int "Character framebuffer font index (-1 picks the smallest)"
	default -1
	range -1 15

config KB_SCREEN_INVERT
	bool "Invert the screen (light text on dark e-paper, dark on lit OLED)"

config KB_SCREEN_EPD_MIN_INTERVAL_MS
	int "Minimum time between e-paper refreshes, in ms"
	default 3000
	range 500 600000
	help
	  E-paper refreshes are slow and wear the panel. Changes inside this
	  window are combined into one refresh. OLEDs ignore this.

config KB_DISPLAY_ROTATE
	bool
	default y
	depends on DT_HAS_DACHSHUND_DISPLAY_ROTATE_ENABLED
	help
	  Software rotation for a portrait e-paper panel
	  (eink-2in13-v4-portrait.overlay).

config KB_DISPLAY_ROTATE_INIT_PRIORITY
	int "Rotated display init priority"
	depends on KB_DISPLAY_ROTATE
	default 86
	help
	  After the panel (DISPLAY_INIT_PRIORITY, 85 by default).

config HEAP_MEM_POOL_ADD_SIZE_KB_SCREEN
	int
	default 8192
	help
	  The character framebuffer allocates the frame buffer from the heap.

endif # KB_SCREEN

endmenu

source "Kconfig.zephyr"
```

## prj.conf
```kconfig
# Base configuration for the keyboard firmware (debug builds).
# Release builds add release.conf: west build ... -- -DEXTRA_CONF_FILE=release.conf

CONFIG_GPIO=y
# QK_RBT in the keymap
CONFIG_REBOOT=y

# USB (device_next stack): boot keyboard with a per-board serial number
# taken from the chip's factory device ID.
CONFIG_USB_DEVICE_STACK_NEXT=y
CONFIG_USBD_HID_SUPPORT=y
CONFIG_HWINFO=y
# Power management (phase 13): the battery gauge on the SAADC, and deep sleep.
CONFIG_ADC=y
CONFIG_POWEROFF=y

# Settings storage on storage_partition (src/storage.c).
CONFIG_FLASH=y
CONFIG_FLASH_MAP=y
CONFIG_FLASH_PAGE_LAYOUT=y

# SK6812 indicator chain on SPIM3, powered through a load switch.
CONFIG_SPI=y
CONFIG_LED_STRIP=y
CONFIG_REGULATOR=y

# Bluetooth LE (src/kb_ble.c): HID over GATT, with one identity (its own
# address) and one bond per host profile, the battery and device
# information services, and the config protocol as vendor reports on the
# HID service. Pairing is Just Works: the board has no display.
CONFIG_BT=y
CONFIG_BT_PERIPHERAL=y
CONFIG_BT_DEVICE_NAME="Dachshund70"
# 961: keyboard (HID subtype)
CONFIG_BT_DEVICE_APPEARANCE=961
CONFIG_BT_MAX_CONN=1
# Host profiles (BT_SEL(0)-BT_SEL(2)); host-lib's BLE_PROFILE_COUNT matches.
CONFIG_BT_ID_MAX=3
CONFIG_BT_MAX_PAIRED=3
CONFIG_BT_SMP=y
CONFIG_BT_SMP_APP_PAIRING_ACCEPT=y
CONFIG_BT_SMP_ALLOW_UNAUTH_OVERWRITE=y
# Some laptops start two link-layer procedures at once and drop the link
# (Nordic's HID keyboard sample has the same workaround).
CONFIG_BT_GATT_AUTO_SEC_REQ=n
CONFIG_BT_AUTO_PHY_UPDATE=n
# Ask for a 7.5-15 ms interval, skipping up to 30 events while idle.
CONFIG_BT_PERIPHERAL_PREF_MIN_INT=6
CONFIG_BT_PERIPHERAL_PREF_MAX_INT=12
CONFIG_BT_PERIPHERAL_PREF_LATENCY=30
CONFIG_BT_PERIPHERAL_PREF_TIMEOUT=400
# 64-byte config reports need an ATT MTU of at least 67.
CONFIG_BT_GATT_CLIENT=y
CONFIG_BT_L2CAP_TX_MTU=247
CONFIG_BT_BUF_ACL_TX_SIZE=251
CONFIG_BT_BUF_ACL_RX_SIZE=251
CONFIG_BT_CTLR_DATA_LENGTH_MAX=251
CONFIG_BT_ATT_TX_COUNT=8

CONFIG_BT_HIDS=y
CONFIG_BT_HIDS_MAX_CLIENT_COUNT=1
# Inputs: keyboard, NKRO, consumer, system, mouse, config. Outputs: LEDs, config.
CONFIG_BT_HIDS_INPUT_REP_MAX=6
CONFIG_BT_HIDS_OUTPUT_REP_MAX=2
CONFIG_BT_HIDS_FEATURE_REP_MAX=0
CONFIG_BT_HIDS_ATTR_MAX=48
CONFIG_BT_HIDS_DEFAULT_PERM_RW_ENCRYPT=y
CONFIG_BT_GATT_UUID16_POOL_SIZE=64
CONFIG_BT_GATT_CHRC_POOL_SIZE=24
CONFIG_BT_CONN_CTX=y

# Battery level comes with power management (phase 13).
CONFIG_BT_BAS=y
CONFIG_BT_DIS=y
CONFIG_BT_DIS_MANUF_NAME=y
CONFIG_BT_DIS_MANUF_NAME_STR="Dachshund"
CONFIG_BT_DIS_MODEL_NUMBER=y
CONFIG_BT_DIS_MODEL_NUMBER_STR="Dachshund70"
# The USB IDs (Kconfig KB_USB_VID/PID), so the configurator finds the board
# over Bluetooth too. Vendor ID source 2: USB-IF.
CONFIG_BT_DIS_PNP=y
CONFIG_BT_DIS_PNP_VID_SRC=2
CONFIG_BT_DIS_PNP_VID=0x1209
CONFIG_BT_DIS_PNP_PID=0x0001

# 2.4 GHz dongle (src/kb_esb.c, Kconfig KB_DONGLE): Enhanced ShockBurst on
# MPSL timeslots next to the Bluetooth controller. Payloads up to 72 bytes
# carry a config frame; the dongle's prj.conf must match.
CONFIG_ESB_MAX_PAYLOAD_LENGTH=72
CONFIG_MPSL_TIMESLOT_SESSION_COUNT=2

# Bonds, identities, the host profile and the preferred output, in NVS on
# bt_settings_partition (CRC-checked and wear-levelled by NVS).
CONFIG_BT_SETTINGS=y
CONFIG_SETTINGS=y
CONFIG_NVS=y
CONFIG_NVS_DATA_CRC=y

# Debug logging over SEGGER RTT (SWD header); the board has no UART.
# Never log typed keystrokes, even here (see CLAUDE.md).
CONFIG_LOG=y
CONFIG_LOG_DEFAULT_LEVEL=3
CONFIG_USE_SEGGER_RTT=y
CONFIG_LOG_BACKEND_RTT=y
CONFIG_USBD_LOG_LEVEL_WRN=y
CONFIG_BT_HIDS_LOG_LEVEL_WRN=y
CONFIG_UDC_DRIVER_LOG_LEVEL_WRN=y
```

## release.conf
```kconfig
# Release overlay: compiles out all logging and asserts.
CONFIG_LOG=n
CONFIG_PRINTK=n
CONFIG_ASSERT=n
```

## boards/nrf52840dongle_nrf52840.conf
```kconfig
# The Pup: the keyboard firmware on Nordic's nRF52840 Dongle (PCA10059).
# Zephyr adds this after prj.conf when building for nrf52840dongle/nrf52840;
# the pins are in boards/Pup/ (firmware/board.overlay).

# The board would otherwise put a CDC ACM console on USB.
CONFIG_BOARD_SERIAL_BACKEND_CDC_ACM=n
# The partitions in boards/Pup/firmware/board.overlay, after Nordic's MBR.
CONFIG_USE_DT_CODE_PARTITION=y

# Same USB IDs as the Dachshund70, so Doghouse finds it; KB_MODEL loads
# boards/Pup/keyboard.json. A USB stick on a port, so no charger to feed.
CONFIG_KB_MODEL="Pup"
CONFIG_KB_USB_PRODUCT="Dachshund Pup"
CONFIG_KB_USB_MAX_POWER_MA=100
CONFIG_BT_DEVICE_NAME="Dachshund Pup"
CONFIG_BT_DIS_MODEL_NUMBER_STR="Pup"

# The recovery key is the only key, so it takes a long hold, and it enters
# Nordic's bootloader (the same as pressing the reset button sideways).
CONFIG_KB_BOOTLOADER_GPREGRET=0xB1
CONFIG_KB_BOOTLOADER_HOLD_MS=10000
```

## app.overlay
```dts
/*
 * USB HID interfaces exposed by the keyboard firmware, and by the dongle,
 * which uses this file too (report formats in
 * firmware/core/include/kb/hid.h):
 * - hid_kbd: boot keyboard, 8-byte 6KRO report and the lock-LED output
 * - hid_extra: NKRO keyboard, consumer and system control, with report IDs
 * - hid_config: the vendor-defined config interface (protocol/protocol.yaml),
 *   64-byte reports both ways over interrupt endpoints
 */

/ {
	hid_kbd: hid_kbd {
		compatible = "zephyr,hid-device";
		label = "Keyboard";
		protocol-code = "keyboard";
		in-report-size = <8>;
		in-polling-period-us = <1000>;
	};

	hid_extra: hid_extra {
		compatible = "zephyr,hid-device";
		label = "Keyboard NKRO and media";
		protocol-code = "none";
		in-report-size = <30>;
		in-polling-period-us = <1000>;
	};

	hid_config: hid_config {
		compatible = "zephyr,hid-device";
		label = "Dachshund config";
		protocol-code = "none";
		in-report-size = <64>;
		in-polling-period-us = <1000>;
		out-report-size = <64>;
		out-polling-period-us = <1000>;
	};
};
```

## boards/nrf52840dongle_nrf52840.overlay
```dts
/*
 * The Pup: the keyboard firmware on Nordic's nRF52840 Dongle. A board
 * overlay here replaces app.overlay, so it brings that too; the pins are in
 * boards/Pup/.
 */
#include "../app.overlay"
#include "../../boards/Pup/firmware/board.overlay"
```

## dts/bindings/dachshund,display-rotate.yaml
```yaml
description: |
  Turns a 1-bit, vertically tiled display (an SSD16xx e-paper panel) by 90 or
  270 degrees in software, so the character framebuffer can draw on it in
  portrait. Choose this node as zephyr,display instead of the panel.

  The SSD16xx driver's own rotation property doesn't help here: it keeps
  reporting the unrotated size, so the character framebuffer draws outside
  the panel.

compatible: "dachshund,display-rotate"

include: base.yaml

properties:
  display:
    type: phandle
    required: true
    description: The panel to draw on.

  rotation:
    type: int
    required: true
    enum: [90, 270]
    description: |
      Clockwise turn from the panel's own landscape picture to the portrait
      one. Try the other value if the text comes out upside down.
```

## src/main.c
```c
/*
 * Keyboard firmware entry point.
 *
 * Matrix scanning and the keymap (phase 3) typing over USB with NKRO,
 * media and system keys (phase 4), the config protocol on a vendor HID
 * interface (phase 5), indicator LEDs for layer and Caps Lock
 * after a power-on walk along the chain, the status screen when a
 * panel overlay is built in, and Bluetooth LE with host profiles
 * (phase 12), with keys going to USB or Bluetooth (output.c), and power
 * management: idle, deep sleep and the battery gauge (phase 13), and the
 * 2.4 GHz dongle (phase 14).
 */

#include <zephyr/kernel.h>
#include <zephyr/logging/log.h>

#include <app_version.h>

#include "kb/core.h"
#include "config.h"
#include "indicators.h"
#include "kb_ble.h"
#include "kb_esb.h"
#include "kb_usb.h"
#include "keyboard.h"
#include "power.h"
#include "status_screen.h"

LOG_MODULE_REGISTER(kb_main, LOG_LEVEL_INF);

int main(void)
{
    LOG_INF("keyboard firmware %s, core api %u", APP_VERSION_STRING,
            (unsigned)kb_core_api_version());

    /* First: it reads why the board started (a key waking it from deep sleep, or not). */
    if (power_init() != 0) {
        LOG_WRN("no battery gauge");
    }

    /* Start the keyboard first: its hold-Esc recovery key works even if USB fails. */
    if (keyboard_start() != 0) {
        LOG_ERR("keyboard unavailable");
    }

    /* Before USB, so the screen sees the first lock-state report. */
    if (IS_ENABLED(CONFIG_KB_SCREEN) && status_screen_init() != 0) {
        LOG_ERR("status screen unavailable");
    }

    /* Before USB, so the first config request finds a listener. */
    if (config_start() != 0) {
        LOG_ERR("config protocol unavailable");
    }

    if (kb_usb_init() != 0) {
        LOG_ERR("USB init failed");
    }

    /* Also loads the preferred output; until then keys prefer USB. */
    if (kb_ble_init() != 0) {
        LOG_ERR("Bluetooth unavailable");
    }

    /* After the settings load (kb_ble_init), which has the paired dongle. */
    if (IS_ENABLED(CONFIG_KB_DONGLE) && kb_esb_init() != 0) {
        LOG_ERR("2.4 GHz radio unavailable");
    }

    /* No LED walk when a key just woke the board: it is in use. */
    if (indicators_start(!power_woke_from_sleep()) != 0) {
        LOG_ERR("indicator LEDs unavailable");
    }

    return 0;
}
```

## src/bootloader.c
```c
#include "bootloader.h"

#include <zephyr/kernel.h>
#include <zephyr/logging/log.h>
#include <zephyr/logging/log_ctrl.h>

#include <soc.h>

LOG_MODULE_REGISTER(bootloader, LOG_LEVEL_INF);

/*
 * GPREGRET value the bootloader checks to stay in update mode: 0x57 for the
 * Adafruit UF2 bootloader (Kconfig KB_BOOTLOADER_GPREGRET).
 */

void bootloader_reboot_to_uf2(void)
{
    LOG_INF("rebooting into UF2 bootloader");
    LOG_PANIC();

    NRF_POWER->GPREGRET = CONFIG_KB_BOOTLOADER_GPREGRET;
    NVIC_SystemReset();
}
```

## src/bootloader.h
```c
/*
 * Reboot into the Adafruit nRF52 UF2 bootloader (on the Pup, Nordic's nRF5
 * bootloader: Kconfig KB_BOOTLOADER_GPREGRET).
 */
#ifndef BOOTLOADER_H
#define BOOTLOADER_H

/*
 * Does not return. The board comes back as a UF2 mass-storage drive.
 * Reached from QK_BOOT in the keymap, or by holding Esc for
 * CONFIG_KB_BOOTLOADER_HOLD_MS (see keyboard.c).
 */
void bootloader_reboot_to_uf2(void);

#endif /* BOOTLOADER_H */
```

## src/config.c
```c
/*
 * Config protocol service. Requests arrive on the USB or Bluetooth thread
 * (or relayed by the dongle),
 * wait in a small queue and are handled one at a time on their own thread,
 * so a slow command (a flash save) never holds up either. Each response
 * goes back the way its request came.
 */

#include "config.h"

#include <errno.h>
#include <string.h>

#include <zephyr/drivers/hwinfo.h>
#include <zephyr/kernel.h>
#include <zephyr/logging/log.h>
#include <zephyr/sys/reboot.h>
#include <zephyr/sys/util.h>

#include <app_version.h>

#include "bootloader.h"
#include "encoder_input.h"
#include "fw_info.h"
#include "indicators.h"
#include "kb/protocol.h"
#include "kb_ble.h"
#include "kb_esb.h"
#include "kb_usb.h"
#include "keyboard.h"
#include "output.h"
#include "power.h"

LOG_MODULE_REGISTER(config, LOG_LEVEL_INF);

#define CONFIG_STACK_SIZE 2048
#define CONFIG_PRIORITY K_PRIO_PREEMPT(5)
/* Long enough for the response to reach the host before the board drops off. */
#define REBOOT_DELAY_MS 100

struct request {
    uint8_t source; /* KB_OUTPUT_USB, KB_OUTPUT_BLE or KB_OUTPUT_DONGLE */
    uint8_t len;
    uint8_t data[KB_PROTO_REPORT_SIZE];
};

K_MSGQ_DEFINE(request_queue, sizeof(struct request), 4, 1);
K_THREAD_STACK_DEFINE(config_stack, CONFIG_STACK_SIZE);
static struct k_thread config_thread_data;

/* git describe of this build; missing when built outside git. */
#ifdef APP_BUILD_VERSION
#define BUILD_ID STRINGIFY(APP_BUILD_VERSION)
#else
#define BUILD_ID "unknown"
#endif

static bool reboot_to_bootloader;

static void reboot_fn(struct k_work *work)
{
    ARG_UNUSED(work);
    if (reboot_to_bootloader) {
        bootloader_reboot_to_uf2();
    } else {
        sys_reboot(SYS_REBOOT_COLD);
    }
}
static K_WORK_DELAYABLE_DEFINE(reboot_work, reboot_fn);

static uint8_t status_of(int err)
{
    switch (err) {
    case 0:
        return KB_PROTO_OK;
    case -ENOSPC:
        return KB_PROTO_STORAGE_FULL;
    default:
        return KB_PROTO_STORAGE_ERROR;
    }
}

static uint8_t op_save(void *ctx)
{
    ARG_UNUSED(ctx);
    return status_of(keyboard_save());
}

static uint8_t op_revert(void *ctx)
{
    ARG_UNUSED(ctx);
    return status_of(keyboard_revert());
}

static uint8_t op_factory_reset(void *ctx)
{
    ARG_UNUSED(ctx);
    return status_of(keyboard_factory_reset());
}

static void op_reboot(bool bootloader, void *ctx)
{
    ARG_UNUSED(ctx);
    LOG_INF("host asked for a reboot%s", bootloader ? " into UF2" : "");
    reboot_to_bootloader = bootloader;
    k_work_schedule(&reboot_work, K_MSEC(REBOOT_DELAY_MS));
}

static void op_identify(uint8_t seconds, void *ctx)
{
    ARG_UNUSED(ctx);
    indicators_identify(seconds);
}

static void op_features_changed(void *ctx)
{
    ARG_UNUSED(ctx);
    keyboard_features_changed();
}

static void op_settings_changed(void *ctx)
{
    ARG_UNUSED(ctx);
    keyboard_settings_changed();
}

static void op_get_connection(struct kb_proto_get_connection_resp *out, void *ctx)
{
    ARG_UNUSED(ctx);
    out->active_output = (uint8_t)output_active();
    out->preferred_output = output_preferred();
    out->usb = kb_usb_ready() ? 1u : 0u;
    out->ble = kb_ble_state();
    out->profile = kb_ble_profile();
    out->bonded = kb_ble_bonded();
}

static uint8_t op_set_output(uint8_t output, void *ctx)
{
    ARG_UNUSED(ctx);
    return output_set_preferred(output) == 0 ? KB_PROTO_OK : KB_PROTO_BAD_VALUE;
}

static uint8_t ble_status(int err)
{
    switch (err) {
    case 0:
        return KB_PROTO_OK;
    case -EINVAL:
        return KB_PROTO_OUT_OF_RANGE;
    default:
        return KB_PROTO_BUSY; /* Bluetooth isn't up */
    }
}

static uint8_t op_select_profile(uint8_t profile, void *ctx)
{
    ARG_UNUSED(ctx);
    return ble_status(kb_ble_select_profile(profile));
}

static uint8_t op_clear_profile(uint8_t profile, void *ctx)
{
    ARG_UNUSED(ctx);
    return ble_status(kb_ble_clear_profile(profile));
}

static void op_get_dongle(struct kb_proto_get_dongle_resp *out, void *ctx)
{
    ARG_UNUSED(ctx);
    kb_esb_get(out);
}

static uint8_t op_pair_dongle(uint8_t mode, void *ctx)
{
    ARG_UNUSED(ctx);
    return kb_esb_pair(mode) == 0 ? KB_PROTO_OK : KB_PROTO_BUSY;
}

static void op_get_power(struct kb_proto_get_power_resp *out, void *ctx)
{
    ARG_UNUSED(ctx);
    power_get(out);
}

static void op_get_timing(struct kb_proto_get_timing_resp *out, bool reset, void *ctx)
{
    ARG_UNUSED(ctx);
    keyboard_timing(out, reset);
}

static void op_lock(void *ctx)
{
    ARG_UNUSED(ctx);
    keyboard_lock();
}

static void op_unlock(void *ctx)
{
    ARG_UNUSED(ctx);
    keyboard_unlock();
}

static const struct kb_protocol_ops base_ops = {
    .save = op_save,
    .revert = op_revert,
    .factory_reset = op_factory_reset,
    .reboot = op_reboot,
    .identify = op_identify,
    .features_changed = op_features_changed,
    .settings_changed = op_settings_changed,
    .get_connection = op_get_connection,
    .set_output = op_set_output,
    .select_profile = op_select_profile,
    .clear_profile = op_clear_profile,
    .get_timing = op_get_timing,
    .lock = op_lock,
    .unlock = op_unlock,
};

/* The ops, plus get_power with a battery gauge and the dongle ops when built in (config_start). */
static struct kb_protocol_ops ops_with_power;

static struct kb_protocol protocol = {
    .ops = &ops_with_power,
    .build = BUILD_ID,
    /* Matrix streaming joins in a later phase; battery once the gauge is up (config_start). */
    .capabilities = KB_PROTO_CAP_KEYMAP | KB_PROTO_CAP_PERSISTENCE | KB_PROTO_CAP_IDENTIFY |
                    KB_PROTO_CAP_ADVANCED_KEYS | KB_PROTO_CAP_MACROS | KB_PROTO_CAP_SETTINGS |
                    KB_PROTO_CAP_INDICATORS | KB_PROTO_CAP_BLUETOOTH | KB_PROTO_CAP_TIMING |
                    KB_PROTO_CAP_FEATURE_SWITCHES,
    .macro_buffer_size = KB_MACRO_BUFFER,
};

/* USB or Bluetooth thread: copy and queue. A host that floods requests loses the extras. */
static void queue_request(uint8_t source, const uint8_t *data, size_t len)
{
    struct request req = {.source = source, .len = (uint8_t)MIN(len, sizeof(req.data))};
    memcpy(req.data, data, req.len);
    if (k_msgq_put(&request_queue, &req, K_NO_WAIT) != 0) {
        LOG_WRN("config request dropped: queue full");
    }
}

static void on_usb_request(const uint8_t *data, size_t len)
{
    queue_request(KB_OUTPUT_USB, data, len);
}

static void on_ble_request(const uint8_t *data, size_t len)
{
    queue_request(KB_OUTPUT_BLE, data, len);
}

static void on_dongle_request(const uint8_t *data, size_t len)
{
    queue_request(KB_OUTPUT_DONGLE, data, len);
}

static int send_response(uint8_t source, const uint8_t *resp)
{
    switch (source) {
    case KB_OUTPUT_BLE:
        return kb_ble_send_config(resp);
    case KB_OUTPUT_DONGLE:
        return IS_ENABLED(CONFIG_KB_DONGLE) ? kb_esb_send_config(resp) : -EAGAIN;
    default:
        return kb_usb_send_config(resp);
    }
}

/*
 * What Doghouse asks every few seconds while it is open. These don't count
 * as use, or an open app would keep a board on battery from ever sleeping.
 */
static bool polled(uint8_t command)
{
    return command == KB_PROTO_CMD_GET_POWER || command == KB_PROTO_CMD_GET_CONNECTION ||
           command == KB_PROTO_CMD_GET_TIMING || command == KB_PROTO_CMD_GET_DONGLE;
}

static void config_thread(void *p1, void *p2, void *p3)
{
    ARG_UNUSED(p1);
    ARG_UNUSED(p2);
    ARG_UNUSED(p3);

    struct request req;
    uint8_t resp[KB_PROTO_REPORT_SIZE];

    for (;;) {
        k_msgq_get(&request_queue, &req, K_FOREVER);
        if (req.len > KB_PROTO_OFF_COMMAND && !polled(req.data[KB_PROTO_OFF_COMMAND])) {
            keyboard_note_activity();
        }
        if (!kb_protocol_handle(&protocol, req.data, req.len, resp)) {
            continue; /* no header to answer */
        }
        int err = send_response(req.source, resp);
        if (err) {
            LOG_WRN("config response dropped (%d)", err);
        }
    }
}

/* Same text as the USB serial number string (uppercase hex of the device ID). */
static char serial[KB_PROTO_GET_SERIAL_RESP_SIZE + 1];

static void load_serial(void)
{
    static const char hex[] = "0123456789ABCDEF";
    uint8_t id[16];
    ssize_t n = hwinfo_get_device_id(id, sizeof(id));

    for (ssize_t i = 0; i < n && (size_t)i * 2 + 1 < sizeof(serial) - 1; i++) {
        serial[i * 2] = hex[id[i] >> 4];
        serial[i * 2 + 1] = hex[id[i] & 0xF];
    }
    protocol.serial = serial;
}

int config_start(void)
{
    /* From the info block, which also keeps it in the image. */
    ops_with_power = base_ops;
    protocol.firmware_major = fw_info.major;
    protocol.firmware_minor = fw_info.minor;
    protocol.firmware_patch = fw_info.patch;
    protocol.model = fw_info.model;
    protocol.keymap = keyboard_keymap();
    protocol.features = keyboard_features();
    protocol.macro_edit = keyboard_macro_edit();
    protocol.settings = keyboard_settings();
    protocol.indicators = keyboard_indicators();
    protocol.encoders = (uint8_t)encoder_input_count();
    if (protocol.encoders > 0) {
        protocol.capabilities |= KB_PROTO_CAP_ENCODERS;
    }
    protocol.ble_profiles = kb_ble_profile_count();
    if (power_has_battery()) {
        protocol.capabilities |= KB_PROTO_CAP_BATTERY;
        ops_with_power.get_power = op_get_power;
    }
    if (IS_ENABLED(CONFIG_KB_DONGLE)) {
        protocol.capabilities |= KB_PROTO_CAP_DONGLE;
        ops_with_power.get_dongle = op_get_dongle;
        ops_with_power.pair_dongle = op_pair_dongle;
        kb_esb_set_config_rx(on_dongle_request);
    }
    load_serial();
    kb_usb_set_config_rx(on_usb_request);
    kb_ble_set_config_rx(on_ble_request);

    k_thread_create(&config_thread_data, config_stack, K_THREAD_STACK_SIZEOF(config_stack),
                    config_thread, NULL, NULL, NULL, CONFIG_PRIORITY, 0, K_NO_WAIT);
    k_thread_name_set(&config_thread_data, "kb_config");
    return 0;
}
```

## src/config.h
```c
/*
 * Config protocol service: answers requests from the host on the config
 * interface (protocol/protocol.yaml), using kb/protocol.h from the core.
 */
#ifndef CONFIG_H
#define CONFIG_H

/* Start the request thread and listen on the USB config interface. */
int config_start(void);

#endif /* CONFIG_H */
```

## src/default_keymap.c
```c
/*
 * Dachshund70 default keymap, as [layer][row][col] over the full 6x15
 * matrix (positions in boards/Dachshund70/README.md). Unused matrix
 * positions are XXXXXXX.
 *
 * Must match host-lib/src/default-keymaps.ts (encoders included), which the mock board and
 * Doghouse use; host-lib's firmware-keymap test compares the two.
 */

#include "default_keymap.h"

const kb_keycode_t default_keymap[DEFAULT_KEYMAP_LAYERS][DEFAULT_KEYMAP_ROWS][DEFAULT_KEYMAP_COLS] = {
    /* 0: Base */
    {
        {KC_ESC, KC_F1, KC_F2, KC_F3, KC_F4, KC_F5, KC_F6, KC_F7, KC_F8, KC_F9, KC_F10, KC_F11, KC_F12, KC_DEL, KC_MUTE},
        {KC_GRV, KC_1, KC_2, KC_3, KC_4, KC_5, KC_6, KC_7, KC_8, KC_9, KC_0, KC_MINS, KC_EQL, KC_BSPC, XXXXXXX},
        {KC_TAB, KC_Q, KC_W, KC_E, KC_R, KC_T, KC_Y, KC_U, KC_I, KC_O, KC_P, KC_LBRC, KC_RBRC, KC_BSLS, XXXXXXX},
        {KC_CAPS, KC_A, KC_S, KC_D, KC_F, KC_G, KC_H, KC_J, KC_K, KC_L, KC_SCLN, KC_QUOT, XXXXXXX, KC_ENT, XXXXXXX},
        {KC_LSFT, KC_Z, KC_X, KC_C, KC_V, KC_B, KC_N, KC_M, KC_COMM, KC_DOT, KC_SLSH, XXXXXXX, KC_RSFT, KC_UP, XXXXXXX},
        {KC_LCTL, KC_LGUI, XXXXXXX, KC_LALT, MO(1), XXXXXXX, KC_SPC, XXXXXXX, KC_RALT, XXXXXXX, MO(1), KC_RCTL, KC_LEFT, KC_DOWN, KC_RGHT},
    },
    /* 1: Fn */
    {
        {QK_BOOT, KC_BRID, KC_BRIU, _______, _______, KC_MPRV, KC_MPLY, KC_MNXT, _______, _______, KC_MUTE, KC_VOLD, KC_VOLU, KC_INS, KC_MPLY},
        {_______, BT_SEL(0), BT_SEL(1), BT_SEL(2), OUT_USB, OUT_2G4, OUT_BLE, _______, _______, _______, BT_CLR, _______, _______, KC_DEL, XXXXXXX},
        {_______, _______, _______, _______, _______, _______, _______, _______, _______, _______, KC_PSCR, KC_SCRL, KC_PAUS, _______, XXXXXXX},
        {_______, _______, _______, _______, _______, _______, _______, _______, _______, _______, _______, _______, XXXXXXX, _______, XXXXXXX},
        {_______, _______, _______, _______, _______, _______, NK_TOGG, _______, _______, _______, _______, XXXXXXX, _______, KC_PGUP, XXXXXXX},
        {_______, _______, XXXXXXX, _______, _______, XXXXXXX, _______, XXXXXXX, _______, XXXXXXX, _______, _______, KC_HOME, KC_PGDN, KC_END},
    },
    /* 2: free for the user */
    {
        {_______, _______, _______, _______, _______, _______, _______, _______, _______, _______, _______, _______, _______, _______, _______},
        {_______, _______, _______, _______, _______, _______, _______, _______, _______, _______, _______, _______, _______, _______, XXXXXXX},
        {_______, _______, _______, _______, _______, _______, _______, _______, _______, _______, _______, _______, _______, _______, XXXXXXX},
        {_______, _______, _______, _______, _______, _______, _______, _______, _______, _______, _______, _______, XXXXXXX, _______, XXXXXXX},
        {_______, _______, _______, _______, _______, _______, _______, _______, _______, _______, _______, XXXXXXX, _______, _______, XXXXXXX},
        {_______, _______, XXXXXXX, _______, _______, XXXXXXX, _______, XXXXXXX, _______, XXXXXXX, _______, _______, _______, _______, _______},
    },
    /* 3: free for the user */
    {
        {_______, _______, _______, _______, _______, _______, _______, _______, _______, _______, _______, _______, _______, _______, _______},
        {_______, _______, _______, _______, _______, _______, _______, _______, _______, _______, _______, _______, _______, _______, XXXXXXX},
        {_______, _______, _______, _______, _______, _______, _______, _______, _______, _______, _______, _______, _______, _______, XXXXXXX},
        {_______, _______, _______, _______, _______, _______, _______, _______, _______, _______, _______, _______, XXXXXXX, _______, XXXXXXX},
        {_______, _______, _______, _______, _______, _______, _______, _______, _______, _______, _______, XXXXXXX, _______, _______, XXXXXXX},
        {_______, _______, XXXXXXX, _______, _______, XXXXXXX, _______, XXXXXXX, _______, XXXXXXX, _______, _______, _______, _______, _______},
    },
};

void default_features(struct kb_features *f)
{
    kb_features_default(f);
    /* The roller: volume on the base layer, tracks on Fn. */
    f->encoders[0][0] = (struct kb_encoder_action){.cw = KC_VOLU, .ccw = KC_VOLD};
    f->encoders[1][0] = (struct kb_encoder_action){.cw = KC_MNXT, .ccw = KC_MPRV};
}
```

## src/default_keymap.h
```c
/*
 * Compiled-in default keymap: the keymap after a factory reset. This file's
 * sizes and default_keymap.c are the Dachshund70's; a board with its own
 * (boards/<name>/firmware/, picked by CMakeLists.txt) defines KB_BOARD_KEYMAP
 * and brings board_keymap.h with the sizes and its own default_keymap.c.
 */
#ifndef DEFAULT_KEYMAP_H
#define DEFAULT_KEYMAP_H

#include "kb/features.h"
#include "kb/keycodes.h"

#ifdef KB_BOARD_KEYMAP
#include "board_keymap.h"
#else
#define DEFAULT_KEYMAP_LAYERS 4
#define DEFAULT_KEYMAP_ROWS 6
#define DEFAULT_KEYMAP_COLS 15
#endif

extern const kb_keycode_t
    default_keymap[DEFAULT_KEYMAP_LAYERS][DEFAULT_KEYMAP_ROWS][DEFAULT_KEYMAP_COLS];

/* Default advanced-key tables: none, apart from the encoder mapping. */
void default_features(struct kb_features *f);

#endif /* DEFAULT_KEYMAP_H */
```

## src/display_rotate.c
```c
/*
 * A display that turns a 1-bit, vertically tiled panel (SSD16xx e-paper) by
 * 90 or 270 degrees, so the character framebuffer can draw on it in portrait.
 * It reports the panel's size with width and height swapped (the height cut
 * to a multiple of 8, as tiles need), takes full frames only, as the
 * character framebuffer writes them, and passes each one to the panel turned
 * back to its own landscape layout.
 */

#define DT_DRV_COMPAT dachshund_display_rotate

#include <errno.h>
#include <string.h>

#include <zephyr/device.h>
#include <zephyr/drivers/display.h>
#include <zephyr/logging/log.h>

#include "kb/screen.h"

LOG_MODULE_REGISTER(display_rotate, LOG_LEVEL_INF);

struct rotate_config {
    const struct device *panel;
    uint16_t rotation;
    uint8_t *frame;     /* the panel's landscape frame */
    size_t frame_size;
};

static void panel_caps(const struct device *dev, struct display_capabilities *caps)
{
    const struct rotate_config *cfg = dev->config;

    display_get_capabilities(cfg->panel, caps);
}

static void rotate_get_capabilities(const struct device *dev, struct display_capabilities *caps)
{
    panel_caps(dev, caps);

    uint16_t w = caps->x_resolution;

    caps->x_resolution = caps->y_resolution;
    caps->y_resolution = w - w % 8u;
}

static int rotate_write(const struct device *dev, const uint16_t x, const uint16_t y,
                        const struct display_buffer_descriptor *desc, const void *buf)
{
    const struct rotate_config *cfg = dev->config;
    struct display_capabilities panel, ours;

    panel_caps(dev, &panel);
    rotate_get_capabilities(dev, &ours);
    if (!(panel.screen_info & SCREEN_INFO_MONO_VTILED)) {
        return -ENOTSUP;
    }
    if (x != 0 || y != 0 || desc->width != ours.x_resolution ||
        desc->height != ours.y_resolution || desc->pitch != desc->width ||
        desc->buf_size < (size_t)desc->width * desc->height / 8u ||
        (size_t)panel.x_resolution * panel.y_resolution / 8u > cfg->frame_size) {
        return -EINVAL;
    }

    int err = kb_screen_rotate(buf, desc->width, desc->height, cfg->frame, panel.x_resolution,
                               panel.y_resolution, cfg->rotation,
                               (panel.screen_info & SCREEN_INFO_MONO_MSB_FIRST) != 0);
    if (err) {
        return err;
    }

    const struct display_buffer_descriptor out = {
        .buf_size = (size_t)panel.x_resolution * panel.y_resolution / 8u,
        .width = panel.x_resolution,
        .height = panel.y_resolution,
        .pitch = panel.x_resolution,
    };
    return display_write(cfg->panel, 0, 0, &out, cfg->frame);
}

static int rotate_blanking_on(const struct device *dev)
{
    const struct rotate_config *cfg = dev->config;

    return display_blanking_on(cfg->panel);
}

static int rotate_blanking_off(const struct device *dev)
{
    const struct rotate_config *cfg = dev->config;

    return display_blanking_off(cfg->panel);
}

static int rotate_set_pixel_format(const struct device *dev, const enum display_pixel_format pf)
{
    const struct rotate_config *cfg = dev->config;

    return display_set_pixel_format(cfg->panel, pf);
}

static int rotate_init(const struct device *dev)
{
    const struct rotate_config *cfg = dev->config;

    if (!device_is_ready(cfg->panel)) {
        LOG_ERR("panel not ready");
        return -ENODEV;
    }
    return 0;
}

static DEVICE_API(display, rotate_api) = {
    .blanking_on = rotate_blanking_on,
    .blanking_off = rotate_blanking_off,
    .write = rotate_write,
    .get_capabilities = rotate_get_capabilities,
    .set_pixel_format = rotate_set_pixel_format,
};

#define PANEL(n) DT_INST_PHANDLE(n, display)
#define FRAME_SIZE(n) (DT_PROP(PANEL(n), width) * DT_PROP(PANEL(n), height) / 8)

#define ROTATE_DEFINE(n)                                                                \
    static uint8_t rotate_frame_##n[FRAME_SIZE(n)];                                     \
    static const struct rotate_config rotate_config_##n = {                             \
        .panel = DEVICE_DT_GET(PANEL(n)),                                               \
        .rotation = DT_INST_PROP(n, rotation),                                          \
        .frame = rotate_frame_##n,                                                      \
        .frame_size = sizeof(rotate_frame_##n),                                         \
    };                                                                                  \
    DEVICE_DT_INST_DEFINE(n, rotate_init, NULL, NULL, &rotate_config_##n, POST_KERNEL,  \
                          CONFIG_KB_DISPLAY_ROTATE_INIT_PRIORITY, &rotate_api);

DT_INST_FOREACH_STATUS_OKAY(ROTATE_DEFINE)
```

## src/encoder_input.c
```c
#include "encoder_input.h"

#include <errno.h>

#include <zephyr/drivers/gpio.h>
#include <zephyr/logging/log.h>
#include <zephyr/spinlock.h>

#include "kb/encoder.h"

LOG_MODULE_REGISTER(encoder, LOG_LEVEL_INF);

#define USER_NODE DT_PATH(zephyr_user)

#if DT_NODE_HAS_PROP(USER_NODE, encoder_a_gpios) && DT_NODE_HAS_PROP(USER_NODE, encoder_b_gpios)

static const struct gpio_dt_spec pin_a = GPIO_DT_SPEC_GET(USER_NODE, encoder_a_gpios);
static const struct gpio_dt_spec pin_b = GPIO_DT_SPEC_GET(USER_NODE, encoder_b_gpios);
static struct kb_encoder decoder;
static bool ready;

static struct gpio_callback pin_cb[2];
static void (*wake_fn)(void);
static struct k_spinlock wake_lock;
static bool armed;

void encoder_input_wake_disarm(void)
{
    K_SPINLOCK(&wake_lock) {
        if (!armed) {
            K_SPINLOCK_BREAK;
        }
        armed = false;
        (void)gpio_pin_interrupt_configure_dt(&pin_a, GPIO_INT_DISABLE);
        (void)gpio_pin_interrupt_configure_dt(&pin_b, GPIO_INT_DISABLE);
    }
}

static void pin_isr(const struct device *port, struct gpio_callback *cb, gpio_port_pins_t pins)
{
    ARG_UNUSED(port);
    ARG_UNUSED(cb);
    ARG_UNUSED(pins);
    encoder_input_wake_disarm();
    if (wake_fn) {
        wake_fn();
    }
}

void encoder_input_set_wake_handler(void (*fn)(void))
{
    wake_fn = fn;
}

/* Either pin leaving the level it rests at now. */
static gpio_flags_t away_from(const struct gpio_dt_spec *pin)
{
    return gpio_pin_get_dt(pin) > 0 ? GPIO_INT_LEVEL_INACTIVE : GPIO_INT_LEVEL_ACTIVE;
}

void encoder_input_wake_arm(void)
{
    if (!ready) {
        return;
    }
    K_SPINLOCK(&wake_lock) {
        if (armed) {
            K_SPINLOCK_BREAK;
        }
        armed = true;
        (void)gpio_pin_interrupt_configure_dt(&pin_a, away_from(&pin_a));
        (void)gpio_pin_interrupt_configure_dt(&pin_b, away_from(&pin_b));
    }
}

int encoder_input_init(void)
{
    const struct gpio_dt_spec *pins[] = {&pin_a, &pin_b};
    for (size_t i = 0; i < ARRAY_SIZE(pins); i++) {
        if (!gpio_is_ready_dt(pins[i])) {
            return -ENODEV;
        }
        int err = gpio_pin_configure_dt(pins[i], GPIO_INPUT);
        if (err) {
            LOG_ERR("encoder pin setup failed (%d)", err);
            return err;
        }
        gpio_init_callback(&pin_cb[i], pin_isr, BIT(pins[i]->pin));
        err = gpio_add_callback_dt(pins[i], &pin_cb[i]);
        if (err) {
            LOG_ERR("encoder interrupt setup failed (%d)", err);
            return err;
        }
    }
    kb_encoder_init(&decoder, gpio_pin_get_dt(&pin_a) > 0, gpio_pin_get_dt(&pin_b) > 0,
                    CONFIG_KB_ENCODER_STEPS_PER_DETENT);
    ready = true;
    return 0;
}

int encoder_input_count(void)
{
    return 1;
}

int encoder_input_poll(int i)
{
    if (!ready || i != 0) {
        return 0;
    }
    return kb_encoder_update(&decoder, gpio_pin_get_dt(&pin_a) > 0, gpio_pin_get_dt(&pin_b) > 0);
}

#else

int encoder_input_init(void)
{
    return 0;
}

void encoder_input_set_wake_handler(void (*fn)(void))
{
    ARG_UNUSED(fn);
}

void encoder_input_wake_arm(void)
{
}

void encoder_input_wake_disarm(void)
{
}

int encoder_input_count(void)
{
    return 0;
}

int encoder_input_poll(int i)
{
    ARG_UNUSED(i);
    return 0;
}

#endif
```

## src/encoder_input.h
```c
/*
 * The rotary encoder's contacts, from encoder-a-gpios and encoder-b-gpios
 * in the board's devicetree (zephyr,user), sampled on the scan thread.
 */
#ifndef ENCODER_INPUT_H
#define ENCODER_INPUT_H

/* Configure the pins. Returns 0, or a negative errno. A board without an encoder has 0 of them. */
int encoder_input_init(void);

/* How many encoders the board has (0 or 1). */
int encoder_input_count(void);

/* Sample encoder i: +1 for a detent clockwise, -1 counter-clockwise, else 0. */
int encoder_input_poll(int i);

/*
 * Wake on a turn while the scan is idle: interrupts on both contacts
 * leaving the level they rest at, calling fn from the interrupt once. The
 * interrupt disarms itself. Set fn before arming.
 */
void encoder_input_set_wake_handler(void (*fn)(void));
void encoder_input_wake_arm(void);
void encoder_input_wake_disarm(void);

#endif /* ENCODER_INPUT_H */
```

## src/fw_info.c
```c
/*
 * This firmware's info block (kb/version.h), read by Doghouse from the .uf2
 * file before an update. The handshake reports the same version and model.
 */
#include "fw_info.h"

#include <zephyr/sys/util.h>

#include <app_version.h>

#include "kb/protocol_gen.h"

BUILD_ASSERT(sizeof(CONFIG_KB_MODEL) - 1 <= KB_FW_INFO_MODEL_MAX, "CONFIG_KB_MODEL is too long");

const struct kb_fw_info fw_info = {
    .magic = {'K', 'B', 'F', 'W', 'I', 'N', 'F', 'O'},
    .layout = KB_FW_INFO_LAYOUT,
    .protocol_version = KB_PROTO_VERSION,
    .major = APP_VERSION_MAJOR,
    .minor = APP_VERSION_MINOR,
    .patch = APP_PATCHLEVEL,
    .model = CONFIG_KB_MODEL,
};
```

## src/fw_info.h
```c
/* This firmware's info block (see kb/version.h). */
#ifndef FW_INFO_H
#define FW_INFO_H

#include "kb/version.h"

extern const struct kb_fw_info fw_info;

#endif /* FW_INFO_H */
```
