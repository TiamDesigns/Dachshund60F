## boards/Dachshund60F/board.yml
```yaml
board:
  name: dachshund60f
  full_name: Dachshund60F
  socs:
    - name: nrf52840
```

## boards/Dachshund60F/dts/bindings/dachshund,display-header.yaml
```yaml
description: |
  Dachshund60F display header J4 (1x8, 2.54 mm), as a GPIO nexus.

  Display overlays refer to header pins by J4 pin number, so pin
  assignments stay in the board files:
    3 DIN, 4 CLK, 5 CS, 6 DC, 7 RST, 8 BUSY (1 is +3V3, 2 is GND).

compatible: "dachshund,display-header"

include: [gpio-nexus.yaml, base.yaml]
```

## boards/Dachshund70/board.yml
```yaml
board:
  name: dachshund70
  full_name: Dachshund70
  socs:
    - name: nrf52840
```
